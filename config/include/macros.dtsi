/ {
    macros {
        // 同时触发两个按键
        macros_2key: macros_2key{
            compatible = "zmk,behavior-macro-two-param";
            #binding-cells = <2>;
            bindings = 
                <&macro_param_1to1>,
                <&macro_press &kp MACRO_PLACEHOLDER>,
                <&macro_param_2to1>,
                <&macro_press &kp MACRO_PLACEHOLDER>,
                <&macro_pause_for_release>,
                <&macro_param_1to1>,
                <&macro_release &kp MACRO_PLACEHOLDER>,
                <&macro_param_2to1>,
                <&macro_release &kp MACRO_PLACEHOLDER>;
        };

        // 抬起一个按键并触发另一个按键
        macros_up_key_tap_key: macros_up_key_tap_key{
            compatible = "zmk,behavior-macro-two-param";
            #binding-cells = <2>;
            bindings = 
                <&macro_param_1to1>,
                <&macro_release &kp MACRO_PLACEHOLDER>,
                <&macro_param_2to1>,
                <&macro_press &kp MACRO_PLACEHOLDER>,
                <&macro_pause_for_release>,
                <&macro_param_2to1>,
                <&macro_release &kp MACRO_PLACEHOLDER>;
        };
    };
};